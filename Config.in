## Config.in
```kconfig
# vim:set syntax=kconfig:
mainmenu "TTLinux Configuration"

config CONFIG_DOT_CONFIG
	bool
	default y

choice
    prompt "Target Architecture"
    default CONFIG_I386
    help
	Stuff
    config CONFIG_ARM
	bool "arm"
    config CONFIG_ARMEB
	bool "armeb"
    config CONFIG_I386
	bool "i386"
    config CONFIG_X86_64
	bool "x86_64"
endchoice

choice
	prompt "Target Architecture Variant"
	depends CONFIG_i386
	default CONFIG_x86_i686
config CONFIG_x86_i386
	bool "i386"
config CONFIG_x86_i486
	bool "i486"
config CONFIG_x86_i586
	bool "i586"
config CONFIG_x86_i686
	bool "i686"
endchoice


menu "Build options"

config CONFIG_LISS
  bool "liss - Build with LiSS series support"
  help
    TTLINUX is almost a one man show, realized in the spare free time of only
    one person. Although it is intended to build a generic dietlibc based
    system, you can compile in some "LiSS series" special features.

config CONFIG_IPV6
  bool "IPv6 - Build with IP version 6 support"
endmenu

source "development/Config.in"
source "base/Config.in"
source "libraries/Config.in"
source "apps/Config.in"


#source "target/Config.in"
```

## apps/Config.in
```kconfig
# vim:set syntax=kconfig:

menu "Applications"
source "apps/sys-fs/Config.in"
source "apps/dns/Config.in"
source "apps/firewall/Config.in"
source "apps/mail/Config.in"
source "apps/vpn/Config.in"
source "apps/internet/Config.in"
source "apps/net/Config.in"
source "apps/net-analyzer/Config.in"
source "apps/development/Config.in"
source "apps/editors/Config.in"
source "apps/sys/Config.in"
source "apps/statistics/Config.in"
endmenu
```

## apps/antivirus/clamav/Config.in
```kconfig
config CONFIG_CLAMAV
  bool "dnsmasq - A GPL virus scanner"
  select CONFIG_GMP
  select CONFIG_ZLIB
  default y
  help
    Clam AntiVirus is a GPL anti-virus toolkit for UNIX. The main purpose of
    this software is the integration with mail servers (attachment scanning).
    The package provides a flexible and scalable multi-threaded daemon, a
    command line scanner, and a tool for automatic updating via Internet. The
    programs are based on a shared library distributed with the Clam AntiVirus
    package, which you can use with your own software. Most importantly, the
    virus database is kept up to date .

    http://www.clamav.net/
```

## apps/archiving/Config.in
```kconfig
# vim set syntax=sh

menu "Archiving"
source "apps/archiving/bzip2"
source "apps/archiving/lzma"
source "apps/archiving/tar"
endmenu
```

## apps/archiving/bzip2/Config.in
```kconfig
config CONFIG_BZIP2
  bool "bzip2 - A high-quality data compressor"
  default n
  help
    http://www.bzip.org/
```

## apps/archiving/lzma/Config.in
```kconfig
config CONFIG_LZMA
  bool "lzma - Average compression ratio is about 30% better than that of gzip"
  default n
  help
    http://tukaani.org/lzma
```

## apps/archiving/tar/Config.in
```kconfig
config CONFIG_TAR
  bool "tar - Use this to make tarballs :)"
  default n
  help
    http://www.gnu.org/software/tar/
```

## apps/debugging/strace/Config.in
```kconfig
# vim:set syntax=kconfig:
config CONFIG_STRACE
  bool "strace - Tracks and displays system calls associated with a running process"
  default n
  help
    The strace program intercepts and records the system calls called and
    received by a running process.  Strace can print a record of each
    system call, its arguments and its return value.  Strace is useful for
    diagnosing problems and debugging, as well as for instructional
    purposes.

    http://sourceforge.net/projects/strace/
```

## apps/development/Config.in
```kconfig
# vim set syntax=sh

menu "Development Tools"
source "apps/development/cvstrac/Config.in"
source "apps/development/svntrac/Config.in"
source "apps/development/pkgconfig/Config.in"
endmenu
```

## apps/development/cvstrac/Config.in
```kconfig
config CONFIG_CVSTRAC
  bool "cvstrac - A Web-Based Bug And Patch-Set Tracking System For CVS"
  select CONFIG_SQLITE_3
  default n
  help
    http://www.cvstrac.org/
```

## apps/development/pkgconfig/Config.in
```kconfig
config CONFIG_PKGCONFIG
  bool "pkgconfig - Package config system that manages compile/link flags"
  default n
  help
    pkg-config is a helper tool used when compiling applications and libraries.
    It helps you insert the correct compiler options on the command line so an
    application can use gcc -o test test.c `pkg-config --libs --cflags glib-2.0`
    for instance, rather than hard-coding values on where to find glib (or
    other libraries). It is language-agnostic, so it can be used for defining
    the location of documentation tools, for instance.
    
    http://pkgconfig.freedesktop.org/
```

## apps/development/svntrac/Config.in
```kconfig
config CONFIG_SVNTRAC
  bool "svntrac - A Web-Based Bug And Patch-Set Tracking System For Subversion"
  select CONFIG_SQLITE_3
  default n
  help
    http://www.cvstrac.org/
```

## apps/dns/Config.in
```kconfig
# vim:set syntax=kconfig:
menu "DNS/DHCP"
  source "apps/dns/djbdns/Config.in"
  source "apps/dns/dnsmasq/Config.in"
  source "apps/dns/ez-ipupdate/Config.in"
  source "apps/dns/dhcp-forwarder/Config.in"
endmenu
```

## apps/dns/dhcp-forwarder/Config.in
```kconfig
config CONFIG_DHCP_FWD
  bool "DHCP Forwarder - forward DHCP messages between subnets"
  default n
  help
    This program forwards DHCP messages between subnets with different sublayer
    broadcast domains. It is similarly to the DHCP relay agent dhcrelay of
    ISC's DHCP, but has the following features which are important for someone:
      
      * Runs as non-root in a chroot-jail
      * Uses "normal" AF_INET sockets; this allows to uses packetfilters to
	filter incoming messages.
      * The DHCP agent IDs can be defined freely
      * Has a small memory footprint when using dietlibc

    It tries to be RFC 2131/2132 and 3046 compliant. Probably it works with
    BOOTP (RFC 951) also, but since the handling of the giaddr field is
    described misleading (see RFC 1542), there may occur problems.

    http://www.nongnu.org/dhcp-fwd/
```

## apps/dns/djbdns/Config.in
```kconfig
config CONFIG_DJBDNS
	bool "djbdns - Excellent high-performance DNS services"
	default n
	help
	  djbdns is a collection of Domain Name System tools. It includes
	  software for all the fundamental DNS operations:
	    DNS cache: finding addresses of Internet hosts.
	    DNS server: publishing addresses of Internet hosts.
	    DNS client: talking to a DNS cache.

	  http://cr.yp.to/djbdns/

config CONFIG_DJBDNS_AXFR_GET
  bool "AXFR_GET"
  depends on CONFIG_DJBDNS

config CONFIG_DJBDNS_AXFRDNS
  bool "AXFRDNS"
  depends on CONFIG_DJBDNS

config CONFIG_DJBDNS_AXFRDNS_CONF
  bool "AXFRDNS_CONF"
  depends on CONFIG_DJBDNS && CONFIG_DJBDNS_AXFRDNS

config CONFIG_DJBDNS_DNSCACHE
  bool "DNSCACHE"
  depends on CONFIG_DJBDNS

config CONFIG_DJBDNS_DNSCACHE_CONF
  bool "DNSCACHE_CONF"
  depends on CONFIG_DJBDNS && CONFIG_DJBDNS_DNSCACHE

config CONFIG_DJBDNS_DNSFILTER
  bool "DNSFILTER"
  depends on CONFIG_DJBDNS

config CONFIG_DJBDNS_DNSIP
  bool "DNSIP"
  depends on CONFIG_DJBDNS

config CONFIG_DJBDNS_DNSIPQ
  bool "DNSIPQ"
  depends on CONFIG_DJBDNS

config CONFIG_DJBDNS_DNSMX
  bool "DNSMX"
  depends on CONFIG_DJBDNS

config CONFIG_DJBDNS_DNSNAME
  bool "DNSNAME"
  depends on CONFIG_DJBDNS

config CONFIG_DJBDNS_DNSQ
  bool "DNSQ"
  depends on CONFIG_DJBDNS

config CONFIG_DJBDNS_DNSQR
  bool "DNSQR"
  depends on CONFIG_DJBDNS && CONFIG_DJBDNS_DNSQ

config CONFIG_DJBDNS_DNSTRACE
  bool "DNSTRACE"
  depends on CONFIG_DJBDNS

config CONFIG_DJBDNS_DNSTRACESORT
  bool "DNSTRACESORT"
  depends on CONFIG_DJBDNS && CONFIG_DJBDNS_DNSTRACE

config CONFIG_DJBDNS_DNSTXT
  bool "DNSTXT"
  depends on CONFIG_DJBDNS

config CONFIG_DJBDNS_PICKDNS
  bool "PICKDNS"
  depends on CONFIG_DJBDNS

config CONFIG_DJBDNS_PICKDNS_CONF
  bool "PICKDNS_CONF"
  depends on CONFIG_DJBDNS && CONFIG_DJBDNS_PICKDNS

config CONFIG_DJBDNS_PICKDNS_DATA
  bool "PICKDNS_DATA"
  depends on CONFIG_DJBDNS && CONFIG_DJBDNS_PICKDNS

config CONFIG_DJBDNS_RANDOW_IP
  bool "RANDOM_IP"
  depends on CONFIG_DJBDNS

config CONFIG_DJBDNS_RBLDNS
  bool "RBLDNS"
  depends on CONFIG_DJBDNS

config CONFIG_DJBDNS_RBLDNS_CONF
  bool "RBLDNS_CONF"
  depends on CONFIG_DJBDNS && CONFIG_DJBDNS_RBLDNS

config CONFIG_DJBDNS_RBLDNS_DATA
  bool "RBLDNS_DATA"
  depends on CONFIG_DJBDNS && CONFIG_DJBDNS_RBLDNS

config CONFIG_DJBDNS_TINYDNS
  bool "TINYDNS"
  depends on CONFIG_DJBDNS
  help
    tinydns is a DNS server. It accepts iterative DNS queries from hosts
    around the Internet, and responds with locally configured information.

config CONFIG_DJBDNS_TINYDNS_CONF
  bool "TINYDNS_CONF - set up a tinydns publication service"
  depends on CONFIG_DJBDNS && CONFIG_DJBDNS_TINYDNS
  help
    tinydns-conf sets up a DNS publication service.

config CONFIG_DJBDNS_TINYDNS_DATA
  bool "tindns_data - create a database suitable for tinydns"
  depends on CONFIG_DJBDNS && CONFIG_DJBDNS_TINYDNS
  help
    tinydns-data reads local DNS information from a file named data in the
    current directory. It creates data.cdb in a binary format designed for
    fast access by tinydns. It may also create some other files with names
    beginning with data.

    tinydns-data updates data.cdb atomically, so you can use it safely while
    tinydns is running. If anything goes wrong with the creation of data.cdb,
    tinydns-data stops and leaves the old data.cdb in place. 

    if unsure, say no.

config CONFIG_DJBDNS_TINYDNS_EDIT
  bool "TINYDNS_EDIT"
  depends on CONFIG_DJBDNS && CONFIG_DJBDNS_TINYDNS

config CONFIG_DJBDNS_TINYDNS_GET
  bool "TINYDNS_GET"
  depends on CONFIG_DJBDNS && CONFIG_DJBDNS_TINYDNS

config CONFIG_DJBDNS_WALLDNS
  bool "WALLDNS"
  depends on CONFIG_DJBDNS 

config CONFIG_DJBDNS_WALLDNS_CONF
  bool "WALLDNS_CONF"
  depends on CONFIG_DJBDNS && CONFIG_DJBDNS_WALLDNS
```

## apps/dns/ez-ipupdate/Config.in
```kconfig
config CONFIG_EZ_IPUPDATE
  bool "ez-ipupdate - update a host name in a dynamic DNS service"
  default n
  help
    'ez-ipupdate' is a small utility for updating your host name for the any of
    the dynamic DNS service offered at:
      * http://www.ez-ip.net
      * http://www.justlinux.com
      * http://www.dhs.org
      * http://www.dyndns.org
      * http://www.ods.org
      * http://gnudip.cheapnet.net (GNUDip)
      * http://www.dyn.ca (GNUDip)
      * http://www.tzo.com
      * http://www.easydns.com
      * http://www.dyns.cx
      * http://www.hn.org
      * http://www.zoneedit.com

    http://www.ez-ipupdate.com/
```

## apps/editors/Config.in
```kconfig
menu "Text editors"
  source "apps/editors/e3/Config.in"
  source "apps/editors/vim/Config.in"
endmenu
```

## apps/editors/vim/Config.in
```kconfig
config CONFIG_VIM
  bool "VIM (VIsual editor iMproved) - The editor of choice"
  default n
  select CONFIG_NCURSES
  help
    VIM (VIsual editor iMproved) is an updated and improved version of the
    vi editor.  Vi was the first real screen-based editor for UNIX, and is
    still very popular.  VIM improves on vi by adding new features:
    multiple windows, multi-level undo, block highlighting and more.

    http://www.vim.org/
```

## apps/firewall/Config.in
```kconfig
# vim:set syntax=kconfig:
menu "Firewall"
  source "apps/firewall/iptables/Config.in"
  source "apps/firewall/ebtables/Config.in"
  source "apps/firewall/conntrackd/Config.in"
  source "apps/firewall/conntrack-tools/Config.in"
endmenu
```

## apps/firewall/conntrack-tools/Config.in
```kconfig
config CONFIG_CONNTRACKTOOLS
  bool "conntrack-tools - A connection tracking userspace daemon and command line interface"
  default y
  select CONFIG_LIBNFNETLINK
  select CONFIG_LIBNETFILTER_CONNTRACK
  help
    The conntrack-tools package contains two programs:
	  
      - conntrack:  the command line interface to interact with the connection
	            tracking system.
			       
      - conntrackd: the connection tracking userspace daemon that can be used to
		    deploy highly available GNU/Linux firewalls and collect
		    statistics of the firewall use.

      http://people.netfilter.org/pablo/conntrackd
```

## apps/firewall/conntrackd/Config.in
```kconfig
config CONFIG_CONNTRACKD
  bool "conntrackd - The connection tracking userspace daemon for Linux"
  default y
  select CONFIG_LIBNFNETLINK
  select CONFIG_LIBNETFILTER_CONNTRACK
  help
	Conntrackd is the userspace daemon for the Netfilter's Connection 
	Tracking System. This daemon maintains a copy of the Connection
	Tracking System in userspace. It is entirely written in C and is
	highly configurable and easily extensible. Currently it covers the
	specific aspects of Stateful Linux firewalls to enable high
	availability solutions and can be used as statistics collector of the
	firewall use.
	
	http://people.netfilter.org/pablo/conntrackd
```

## apps/firewall/ebtables/Config.in
```kconfig
# vim:set syntax=kconfig:
config CONFIG_EBTABLES
  bool "ebtables - A filtering tool for a bridging firewall."
  default y
  help
    ebtables program is a filtering tool for a bridging firewall. The
    filtering is focused on the Link Layer Ethernet frame fields. Apart
    from filtering, it also gives the ability to alter Ethernet MAC
    addresses and implement a brouter.

    http://ebtables.sourceforge.net/
```

## apps/firewall/iptables/Config.in
```kconfig
config CONFIG_IPTABLES
  bool "iptables - Linux kernel (2.4+) firewall, NAT and packet mangling tools"
  default y
  help
	iptables is the userspace command line program used to configure the Linux
	2.4.x and 2.6.x IPv4 packet filtering ruleset. It is targeted towards system
	administrators.

	Since Network Address Translation is also configured from the packet filter
	ruleset, iptables is used for this, too. 
	
	http://www.netfilter.org/projects/iptables/
```

## apps/internet/Config.in
```kconfig
#curl
#fnord
#hping2
#mathopd
#mini_httpd
#openntpd
#tcpdump
#thttpd
#thy
menu "Proxy"
source "apps/internet/tinyproxy/Config.in"
source "apps/internet/squid32/Config.in"
source "apps/internet/c_icap/Config.in"
source "apps/internet/gnu-httptunnel/Config.in"
endmenu
#uucp
```
