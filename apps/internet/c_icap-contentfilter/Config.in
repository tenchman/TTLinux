## apps/internet/c_icap-contentfilter/Config.in
```kconfig
# vim:set syntax=kconfig:
config CONFIG_C_ICAP_CONTENTFILTER
  bool "C-icap - Contentfilter plugin for c-icap"
  depends CONFIG_C_ICAP
  default n
  help

    https://svn.telco-tech.de/projects/c-icap-plugins
```

## apps/internet/c_icap-ofcd/Config.in
```kconfig
# vim:set syntax=kconfig:
config CONFIG_C_ICAP_OFCD
  bool "C-icap-ofcd - OFCD (Orange Filter Caching Daemon) plugin for c-icap"
  depends CONFIG_C_ICAP
  default n
  help

    https://svn.telco-tech.de/projects/c-icap-plugins
```

## apps/internet/c_icap/Config.in
```kconfig
# vim:set syntax=kconfig:
config CONFIG_C_ICAP
  bool "C-icap - an ICAP server coded in C"
  default n
  help

    http://sourceforge.net/projects/c-icap/

source "apps/internet/c_icap-contentfilter/Config.in"
source "apps/internet/c_icap-ofcd/Config.in"
```

## apps/internet/gnu-httptunnel/Config.in
```kconfig
# vim:set syntax=kconfig:
config CONFIG_GNUHTTPTUNNEL
  bool "GNU httptunnel - A program to tunnel arbitrary TCP connections over HTTP."
  default n
  help
    httptunnel creates a bidirectional virtual data connection tunnelled in
    HTTP requests. The HTTP requests can be sent via an HTTP proxy if so desired.

    This can be useful for users behind restrictive firewalls. If WWW access is
    allowed through a HTTP proxy, it's possible to use httptunnel and, say, telnet
    or PPP to connect to a computer outside the firewall.

    http://www.nocrew.org/software/httptunnel.html
```

## apps/internet/squid32/Config.in
```kconfig
config CONFIG_SQUID3
	bool "Squid - Squid Web Proxy Cache"
	default n
 	help
	  Squid is a high performance Web proxy cache that can be arranged
	  hierarchically for an improvement in response times and a reduction in
	  bandwith usage. Squid runs on all popular Unix and Windows platforms.

	  http://www.squid-cache.org/
```

## apps/internet/tinyproxy-ex/Config.in
```kconfig
# vim:set syntax=kconfig:
config CONFIG_TINYPROXY
	bool "Tinyproxy - A lightweight HTTP/HTTPS proxy"
	default n
 	help
	  tinyproxy is a lightweight HTTP proxy licensed under the GPL.
	  Designed from the ground up to be fast and yet small, it is an
	  ideal solution for sites where a full-featured HTTP proxy is
	  required, but the system resources required to run a more demanding
	  HTTP proxy are unavailable.
	  
	  http://tinyproxy.sourceforge.net/

config CONFIG_TINYPROXY_STATIC
	bool "  Build static executable"
	depends on CONFIG_TINYPROXY
	default y

config CONFIG_TINYPROXY_UPSTREAM
	bool "  Enable support for upstream proxies"
	depends on CONFIG_TINYPROXY
	default y

config CONFIG_TINYPROXY_FILTER
	bool "  Enable filtering of domains/URLs"
	depends on CONFIG_TINYPROXY
	default y

config CONFIG_TINYPROXY_TRANSPARENT
	bool "  Enable transparent proxy support"
	depends on CONFIG_TINYPROXY
	default y
```

## apps/mail/Config.in
```kconfig
# vim:set syntax=kconfig:
menu "Mailserver & Filters"
  source "apps/mail/bogofilter/Config.in"
#  source "apps/mail/qsf/Config.in"
  source "apps/mail/qmail/Config.in"
  source "apps/mail/ripmime/Config.in"
  source "apps/mail/saucer/Config.in"
  source "apps/mail/p3scan/Config.in"
endmenu
```

## apps/mail/bogofilter/Config.in
```kconfig
config CONFIG_BOGOFILTER
  bool "Bogofilter - A Bayesian spam filter."
  default y
  help
	Bogofilter is a Bayesian spam filter. In its normal mode of operation, it
	takes an email message or other text on standard input, does a statistical
	check against lists of "good" and "bad" words, and returns a status code
	indicating whether or not the message is spam. Bogofilter is designed with
	fast algorithms (including Berkeley DB system), coded directly in C, and
	tuned for speed, so it can be used for production by sites that process a
	lot of mail.

	http://www.bogofilter.org

config CONFIG_BOGOFILTER_QDBM
	bool "Use Qdbm as database backend"
	select CONFIG_QDBM
	depends on CONFIG_BOGOFILTER
	default y
```

## apps/mail/greylisting-spp/Config.in
```kconfig
# vim:set syntax=kconfig:
config CONFIG_GREYLISTING
  bool "greylisting-spp - reject incoming email, unless delivery was tried before."
  default n
  select CONFIG_UCSPI_TCP
  select CONFIG_UCSPI_TCP_TCPRULES
  depends on CONFIG_QMAIL

config CONFIG_GREYLISTING_SQLITE
  bool "use Sqlite3 as database backend"
  default n
  select CONFIG_SQLITE_3
  depends on CONFIG_GREYLISTING

config CONFIG_GREYLISTING_STATIC
  bool "build a statically linked executable"
  default y
  depends on CONFIG_GREYLISTING
```

## apps/mail/p3scan/Config.in
```kconfig
# vim:set syntax=kconfig:
config CONFIG_P3SCAN
  bool "p3scan - Transparent POP3 Proxy"
  default n
  help
    A full-transparent proxy-server for email clients.

    http://p3scan.sourceforge.net/
```

## apps/mail/qmail/Config.in
```kconfig
# vim:set syntax=kconfig:
config CONFIG_QMAIL
  bool "QMail - A modern replacement for sendmail"
  default y
  select CONFIG_MATRIXSSL
  help
	Qmail is a small, fast, secure replacement for the sendmail package,
	which is the program that actually receives, routes, and delivers
	electronic mail.  *** Note: Be sure and read the documentation as there
	are some small but very significant differences between sendmail and
	qmail and the programs that interact with them.
	(Decsription shameless ripped from: qmail-1.03-1.i386.rpm)

	http://www.qmail.org

source "apps/mail/greylisting-spp/Config.in"
```

## apps/mail/ripmime/Config.in
```kconfig
config CONFIG_RIPMIME
  bool "ripMIME - Extracts attachments out of mailpack format emails"
  default y
  help
	ripMIME is a small program which has been developed as part of the
	commercial Xamime development (http://www.xamime.com).

	ripMIME has been written with one sole purpose in mind, to extract
	the attached files out of a MIME encoded email package.

	http://www.pldaniels.com/ripmime/
```

## apps/mail/saucer/Config.in
```kconfig
# vim:set syntax=kconfig:
config CONFIG_SAUCER
  bool "Saucer - Spam and useless content eater"
  default y
  select CONFIG_PCRE
  select CONFIG_LIBSPF
```

## apps/net-analyzer/Config.in
```kconfig
menu "Network analyzer"
  source "apps/net-analyzer/netcat/Config.in"
  source "apps/net-analyzer/snort/Config.in"
  source "apps/net-analyzer/tcpdump/Config.in"
endmenu
```

## apps/net-analyzer/snort/Config.in
```kconfig
# vim:set syntax=kconfig:
config CONFIG_SNORT
  bool "snort - Libpcap-based packet sniffer/logger/lightweight IDS"
  select CONFIG_LIBPCAP
  default n
  help

    http://www.snort.org/
```

## apps/net-analyzer/tcpdump/Config.in
```kconfig
# vim:set syntax=kconfig:
config CONFIG_TCPDUMP
  bool "tcpdump - A network traffic monitoring tool"
  select CONFIG_LIBPCAP
  default n
  help
    Tcpdump is a command-line tool for monitoring network traffic.
    Tcpdump can capture and display the packet headers on a particular
    network interface or on all interfaces.  Tcpdump can display all of
    the packet headers, or just the ones that match particular criteria.

    Install tcpdump if you need a program to monitor network traffic.

    http://www.tcpdump.org
```

## apps/net-analyzer/yws/Config.in
```kconfig
# vim:set syntax=kconfig:
config CONFIG_YWS
  bool "yws - Yes, we scan"
  select CONFIG_SQLITE_3
  default n
  help
    A really nice Package description and everything about it

    http://www.package.org/
```

## apps/net/Config.in
```kconfig
# vim:set syntax=kconfig:
menu "Networking"
  source "apps/net/keepalived/Config.in"
  source "apps/net/net-snmp/Config.in"
  source "apps/net/samba/Config.in"
  source "apps/net/wakelan/Config.in"
  source "apps/net/dropbear/Config.in"
  source "apps/net/traceroute/Config.in"
  source "apps/net/ifplugd/Config.in"
endmenu
```

## apps/net/capi4k-utils/Config.in
```kconfig
# vim:set syntax=kconfig:
config CONFIG_CAPI4K
  bool "capi4k-utils - CAPI 2.0 Utilities"
  default y
  depends CONFIG_PPP
  help
    This package contains the CAPI 2.0 library, which is needed for all
    CAPI applications. It also contains programs to show information about
    installed CAPI controllers and for the receiving and sending of FAX
    messages. CAPI 2.0 drivers for Linux are available for a growing
    number of ISDN devices.
    
    ftp://ftp.in-berlin.de/pub/capi4linux/
```

## apps/net/dropbear/Config.in
```kconfig
# vim:set syntax=kconfig:
config CONFIG_DROPBEAR
  bool "Dropbear - SSH 2 Server/Client"
  default y
  help
    Dropbear is a relatively small SSH 2 server and client. It runs on a
    variety of POSIX-based platforms. Dropbear is open source software,
    distributed under a MIT-style license. Dropbear is particularly useful
    for "embedded"-type Linux (or other Unix) systems, such as wireless
    routers.
    
    http://matt.ucc.asn.au/dropbear/dropbear.html

  config CONFIG_DROPBEAR_ONETIME
    bool "Support for onetime passwords"
    default n
    depends CONFIG_DROPBEAR

  config CONFIG_DROPBEAR_BLACKLIST
    bool "Support for blacklisting after a configurable amount of failed logins"
    default n
    depends CONFIG_DROPBEAR

  config CONFIG_DROPBEAR_SYSLOG
    bool "Support for syslog"
    default n
    depends CONFIG_DROPBEAR
```

## apps/net/ifplugd/Config.in
```kconfig
# vim:set syntax=kconfig:
config CONFIG_IFPLUGD
  bool "ifplugd - Brings up/down ethernet ports automatically with cable detection"
  default n
  select CONFIG_LIBDAEMON
  help
    ifplugd is a Linux daemon which will automatically configure your ethernet
    device when a cable is  plugged in and automatically unconfigure it if the
    cable is  pulled. This is useful on laptops  with onboard network adapters,
    since  it  will  only  configure  the interface  when a  cable  is  really
    connected.

    http://www.package.org/
```

## apps/net/keepalived/Config.in
```kconfig
# vim:set syntax=kconfig:
config CONFIG_KEEPALIVED
  bool "keepalived - HA monitor built upon LVS, VRRP and service pollers"
  select CONFIG_OPENSSL
  select CONFIG_LIBPOPT
  default n
  help
    Keepalived for LVS aims to add a strong and robust keepalive facility
    to the Linux Virtual Server project. This project is written in C with
    multilayer TCP/IP stack checks. It implements a framework based on three
    family checks: Layer3, Layer4, and Layer5. This framework gives the daemon
    the ability of checking a LVS server pool states. When one of the servers
    in the LVS server pool is down, keepalived informs the Linux kernel via a
    setsockopt call to remove this server entry from the LVS topology. In
    addition, it implements a VRRPv2 stack to handle director failover.
    
    http://www.keepalived.org/

  config CONFIG_KEEPALIVED_STATIC
    bool "build static executables"
    default n
    depends CONFIG_KEEPALIVED

  choice
    prompt "Framework to use"
    default CONFIG_KEEPALIVED_FRAMEWORK_VRRP
		     
    config CONFIG_KEEPALIVED_FRAMEWORK_VRRP
      bool "VRRP framework"

    config CONFIG_KEEPALIVED_FRAMEWORK_LVS
      bool "LVS framework"

  endchoice
```

## apps/net/net-snmp/Config.in
```kconfig
# vim:set syntax=kconfig:
config CONFIG_NET_SNMP
  bool "net-snmp - A collection of SNMP protocol tools and libraries"
  default n
  help
    SNMP (Simple Network Management Protocol) is a protocol used for
    network management. The NET-SNMP project includes various SNMP tools:
    an extensible agent, an SNMP library, tools for requesting or setting
    information from SNMP agents, tools for generating and handling SNMP
    traps and a version of the netstat command which uses SNMP.

    http://net-snmp.sourceforge.net/
config CONFIG_NET_SNMP_DEBUG
  bool "build net-snmp with debugging code"
  default n
  depends on CONFIG_NET_SNMP
  help
    Enabling this option builds the net-snmp package with debugging support.
		This is required for the -D options to work.
config CONFIG_NET_SNMP_SSL
  bool "build net-snmp with SSL (required for SHA/DES/AES)"
  default y
  depends on CONFIG_NET_SNMP
  help
    Enabling this option builds the net-snmp package with SSL support.
    This is required for SHA authentication and DES or SHA encryption
    with SNMPv3.
config CONFIG_NET_SNMP_TELCO_TECH_MIB
  bool "build the TELCO-TECH-MIB module"
  default y
  depends on CONFIG_NET_SNMP
  help
    Enabling this option builds the TELCO-TECH-MIB module from code
    generated with mib2c from the TELCO-TECH-MIB, LISS-MIB and
    LISS-MANSEC-MIB text files.
config CONFIG_NET_SNMP_LISS_RW_COMPLIANCE
  bool "build a LISS-MIB read/write compliant TELCO-TECH-MIB module."
  default y
  depends on CONFIG_NET_SNMP_TELCO_TECH_MIB
  help
    Enabling this option builds a TELCO-TECH-MIB module which is a
    read/write compliant implementation of the LISS-MIB module.
    Disabling this option results in a read-only compliant
    implementation to be built.
config CONFIG_NET_SNMP_LISS_FULL_COMPLIANCE
  bool "build a LISS-MIB fully compliant TELCO-TECH-MIB module."
  default y
  depends on CONFIG_NET_SNMP_LISS_RW_COMPLIANCE
  help
    Enabling this option builds a TELCO-TECH-MIB module which is a
    read/write compliant implementation of the LISS-MIB module.
    Disabling this option results in a read-only implementation to be
    built.
config CONFIG_NET_SNMP_LISS_MANSEC_FULL_COMPLIANCE
  bool "build a LISS-MANSEC-MIB fully compliant TELCO-TECH-MIB module."
  default y
  depends on CONFIG_NET_SNMP_LISS_RW_COMPLIANCE
  help
    Enabling this option builds a TELCO-TECH-MIB module which is a
    fully compliant implementation of the LISS-MANSEC-MIB module.
```

## apps/net/samba/Config.in
```kconfig
config CONFIG_SAMBA
  bool "SAMBA - a suite of SMB and CIFS client/server programs for UNIX"
  default n
  help

    http://www.samba.org

config CONFIG_SAMBA_LDAP
  bool "use LDAP"
  depends on CONFIG_SAMBA
  select CONFIG_OPENLDAP
  default n

config CONFIG_SAMBA_CUPS
  bool "Cups printing support"
  depends on CONFIG_SAMBA
  select CONFIG_CUPS
  default n
```

## apps/net/traceroute/Config.in
```kconfig
# vim:set syntax=kconfig:
config CONFIG_TRACEROUTE
  bool "traceroute - Traces the route taken by packets over an IPv4/IPv6 network"
  default y
  help
    The traceroute utility displays the route used by IP packets on their
    way to a specified network (or Internet) host.  Traceroute displays
    the IP number and host name (if possible) of the machines along the
    route taken by the packets.  Traceroute is used as a network debugging
    tool.  If you're having network connectivity problems, traceroute will
    show you where the trouble is coming from along the route.

    Install traceroute if you need a tool for diagnosing network connectivity

    http://dmitry.butskoy.name/traceroute
```
