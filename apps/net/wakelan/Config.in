## apps/net/wakelan/Config.in
```kconfig
config CONFIG_WAKELAN
  bool "wakelan - Send a wake-on-lan packet"
  default n
  help
    WakeLan sends a properly formatted UDP packet across the
    network which will cause a wake-on-lan enabled computer to
    power on.
  
    ftp://metalab.unc.edu/pub/Linux/system/network/misc/
```

## apps/statistics/Config.in
```kconfig
# vim:set syntax=kconfig:

menu "Statistics"
source "apps/statistics/collectd/Config.in"
source "apps/statistics/rrdtool/Config.in"
source "apps/statistics/hddtemp/Config.in"
source "apps/statistics/lm_sensors/Config.in"
endmenu
```

## apps/statistics/collectd/Config.in
```kconfig
# vim:set syntax=kconfig:
config CONFIG_COLLECTD
  bool "collectd - A daemon which collects system performance statistics"
  default n
  select CONFIG_NET_SNMP
  help
    Collectd is a small and modular daemon which collects system information
    periodically and provides means to store the values. Included in the
    distribution are numerous plug-ins for collecting CPU, disk, and memory
    usage, network interface and DNS traffic, network latency, database
    statistics, and much more. Custom statistics can easily be added in a
    number of ways, including execution of arbitrary programs and plug-ins
    written in Perl. Advanced features include a powerful network code to
    collect statistics for entire setups and SNMP integration to query
    network equipment.

    http://collectd.org/
  
  config CONFIG_COLLECTD_RRDTOOL
    bool "compile in support for rrdtool"
    default n
    depends CONFIG_COLLECTD
    select CONFIG_RRDTOOL
    select CONFIG_FREETYPE
  
  config CONFIG_COLLECTD_IPTABLES
    bool "compile in support for iptables"
    default y
    depends CONFIG_COLLECTD
    select CONFIG_IPTABLES
  
  config CONFIG_COLLECTD_NETLINK
    bool "compile in netlink support"
    default y
    depends CONFIG_COLLECTD
    select CONFIG_IPROUTE
  
  config CONFIG_COLLECTD_LM_SENSORS
    bool "compile in support for lm_sensors"
    default y
    depends CONFIG_COLLECTD
    select CONFIG_LM_SENSORS
```

## apps/statistics/hddtemp/Config.in
```kconfig
# vim:set syntax=kconfig:
config CONFIG_HDDTEMP
  bool "hddtemp - small utility to read hard drive temperature"
  default n
  help
    hddtemp is a small utility that gives you the temperature of your hard
    drive by reading S.M.A.R.T. informations (for drives that support this
    feature).
    Note: only recent hard drives have a temperature sensor.

    http://www.guzu.net/linux/hddtemp.php
```

## apps/statistics/lm_sensors/Config.in
```kconfig
# vim:set syntax=kconfig:
config CONFIG_LM_SENSORS
  bool "lm_sensors - Linux sensors drivers and hardware monitoring tools."
  default n
  depends CONFIG_SYSFSUTILS
  help
    lm_sensors  provides  essential  tools  and  drivers  for  monitoring  the
    temperatures, voltages, and fans of Linux systems with hardware monitoring
    devices. It contains Linux 2.4 drivers for  sensor chips and I2C and SMBus
    masters, text-based  tools for sensor reporting, and a library for sensors
    access  called "libsensors".  It also  contains tools for  sensor hardware
    identification and I2C bus probing.

    http://www.lm-sensors.org/
  
  config CONFIG_LM_SENSORS_SENSORD
    bool "compile in sensord support"
    default y
    depends CONFIG_LM_SENSORS
    select CONFIG_RRDTOOL
    help
      You doesn't need this if you use collectd with lm_sensors support.

      If you are unsure, answer N.
```

## apps/statistics/rrdtool/Config.in
```kconfig
# vim:set syntax=kconfig:
config CONFIG_RRDTOOL
  bool "rrdtool - Time-series data storage and graphing software"
  default n
  select CONFIG_FREETYPE
  select CONFIG_LIBART_LGPL
  select CONFIG_LIBPNG
  select CONFIG_ZLIB
  help
    RRDtool (Round  Robin  Database  Tool) is time-series  data  storage and
    graphing utility created  by the author  of MRTG. Using RRDtool, you can
    write your own MRTG-like tools in a matter minutes with only a few lines
    of Perl or shell code.

    http://oss.oetiker.ch/rrdtool/
```

## apps/sys-fs/Config.in
```kconfig
# vim:set syntax=kconfig:

menu "Filesystem utils"
source "apps/sys-fs/e2fsprogs/Config.in"
source "apps/sys-fs/drbd/Config.in"
source "apps/sys-fs/ocfs2/Config.in"
source "apps/sys-fs/inotify-tools/Config.in"
endmenu
```

## apps/sys-fs/drbd/Config.in
```kconfig
# vim:set syntax=kconfig:
config CONFIG_DRBD
  bool "drbd - DRBD userland tools. (Distributed Redundant Block Device)"
  default n
  help
    Drbd is a distributed replicated block device. It mirrors a
    block device over the network to another machine. Think of it
    as networked raid 1. It is a building block for setting up
    high availability (HA) clusters.

    http://www.drbd.org/
```

## apps/sys-fs/e2fsprogs/Config.in
```kconfig
# vim:set syntax=kconfig:
config CONFIG_E2FSPROGS
  bool "e2fsprogs - Utilities for managing ext2/ext3 filesystems"
  default n
  help
    The e2fsprogs package contains a number of utilities for creating,
    checking, modifying, and correcting any inconsistencies in second
    and third extended (ext2/ext3) filesystems. E2fsprogs contains
    e2fsck (used to repair filesystem inconsistencies after an unclean
    shutdown), mke2fs (used to initialize a partition to contain an
    empty ext2 filesystem), debugfs (used to examine the internal
    structure of a filesystem, to manually repair a corrupted
    filesystem, or to create test cases for e2fsck), tune2fs (used to
    modify filesystem parameters), and most of the other core ext2fs
    filesystem utilities.

    You should install the e2fsprogs package if you need to manage the
    performance of an ext2 and/or ext3 filesystem.

    http://e2fsprogs.sourceforge.net/
```

## apps/sys-fs/inotify-tools/Config.in
```kconfig
# vim:set syntax=kconfig:
config CONFIG_INOTIFY_TOOLS
  bool "inotify-tools - Command line utilities for inotify"
  default n
  help
    inotify-tools is a set of command-line programs for Linux providing
    a simple interface to inotify. These programs can be used to monitor
    and act upon filesystem events.

    http://inotify-tools.sourceforge.net/
```

## apps/sys-fs/ocfs2/Config.in
```kconfig
# vim:set syntax=kconfig:
config CONFIG_OCFS2
  select CONFIG_E2FSPROGS
  bool "ocfs2-tools - OCFS2 userland tools. (Oracle Cluster FileSystem)"
  select CONFIG_LIBCOMERR
  default n
  help
    OCFS2 is a general purpose extent based shared disk cluster file
    system with many similarities to ext3.

    http://oss.oracle.com/projects/ocfs2-tools/
```

## apps/sys/Config.in
```kconfig
# vim:set syntax=kconfig:
menu "System utillities"
  source "apps/sys/ethtool/Config.in"
  source "apps/sys/hdparm/Config.in"
  source "apps/sys/htop/Config.in"
  source "apps/sys/sysfsutils/Config.in"
endmenu
```

## apps/sys/ethtool/Config.in
```kconfig
# vim:set syntax=kconfig:
config CONFIG_ETHTOOL
  bool "ethtool - Ethernet settings tool for PCI ethernet cards"
  default n
  help
    ethtool is a Linux net driver diagnostic and tuning tool for the Linux
    2.4.x (or later) series of kernels. Obtain information and diagnostics
    related to  media, link  status, driver  version, PCI  (or other)  bus
    location, and more.

    http://sourceforge.net/projects/gkernel/
```

## apps/sys/hdparm/Config.in
```kconfig
# vim:set syntax=kconfig:
config CONFIG_HDPARM
  bool "hdparm - Utility for manipulating Linux IDE drive/driver parameters"
  default n
  help
    hdparm is a Linux shell utility for viewing and manipulating various IDE
    drive and driver parameters. Most drives can benefit from improved
    performance using a command similar to
      
      "hdparm -qm8 -qu1 -qc1 -qd1 /dev/hda".

    http://sourceforge.net/projects/hdparm/
```

## apps/sys/sysfsutils/Config.in
```kconfig
# vim:set syntax=kconfig:
config CONFIG_SYSFSUTILS
  bool "sysfsutils - library interface to sysfs"
  default n
  help
    This package's purpose is to provide a set of utilities for interfacing
    with sysfs.

    http://linux-diag.sourceforge.net/
```

## apps/sys/util-linux-ng/Config.in
```kconfig
# vim:set syntax=kconfig:
config CONFIG_UTIL_LINUX_NG
  bool "util-linux - A collection of basic system utilities"
  default n
  help
    The util-linux package contains a large variety of low-level system
    utilities that are necessary for a Linux system to function. Among
    others, Util-linux contains the fdisk configuration tool and the login
    program.
```

## apps/vpn/Config.in
```kconfig
menu "Virtual private network"
  source "apps/vpn/openvpn-1.x/Config.in"
  source "apps/vpn/openvpn-2.0/Config.in"
  source "apps/vpn/openvpn-2.1/Config.in"
  source "apps/vpn/openswan/Config.in"
  source "apps/vpn/openswan-3.x/Config.in"
  source "apps/vpn/strongswan-2.x/Config.in"
  source "apps/vpn/ipsec-tools/Config.in"
endmenu
```

## apps/vpn/ipsec-tools/Config.in
```kconfig
# vim:set syntax=kconfig:
config CONFIG_IPSEC_TOOLS
  bool "ipsec-tools - A port of KAME's IPsec utilities to the Linux"
  default n
  select CONFIG_OPENSSL
  help
    IPsec-Tools is a port of KAME's IPsec utilities to the Linux-2.6 IPsec
    implementation. It supports NetBSD and FreeBSD as well.

    http://ipsec-tools.sourceforge.net/
```

## apps/vpn/openswan-2.6/Config.in
```kconfig
config CONFIG_OPENSWAN_26
  bool "openswan-2.6 - an Open Source implementation of IPsec for Linux (2.x)"
  default n
  select CONFIG_GMP
  help
    Openswan is an Open Source implementation of IPsec for the Linux operating
    system. It is a code fork of the FreeS/WAN project, started by a few of the
    developers who were growing frustrated with the politics surrounding the
    FreeS/WAN project.

    http://www.openswan.org/
```

## apps/vpn/openswan-3.x/Config.in
```kconfig
config CONFIG_OPENSWAN_3
  bool "openswan-3 - an Open Source implementation of IPsec for Linux (3.x)"
  default n
  select CONFIG_GMP
  help
    Openswan is an Open Source implementation of IPsec for the Linux operating
    system. It is a code fork of the FreeS/WAN project, started by a few of the
    developers who were growing frustrated with the politics surrounding the
    FreeS/WAN project.

    http://www.openswan.org/
```

## apps/vpn/openswan/Config.in
```kconfig
config CONFIG_OPENSWAN
  bool "openswan-2.4 - an Open Source implementation of IPsec for Linux (2.x)"
  default n
  select CONFIG_GMP
  help
    Openswan is an Open Source implementation of IPsec for the Linux operating
    system. It is a code fork of the FreeS/WAN project, started by a few of the
    developers who were growing frustrated with the politics surrounding the
    FreeS/WAN project.

    http://www.openswan.org/
```

## apps/vpn/openvpn-1.x/Config.in
```kconfig
config CONFIG_OPENVPN_1
  bool "openvpn1 - A full-featured SSL VPN solution"
  default n
  select CONFIG_LIBLZO
  select CONFIG_OPENSSL
  help
    OpenVPN is a full-featured SSL VPN solution which can 
    accomodate a wide range of configurations, including road 
    warrior access, home/office/campus telecommuting, WiFi 
    security, secure branch office linking, and enterprise-scale 
    remote access solutions with load balancing, failover, and 
    fine-grained access-controls.

    http://openvpn.sourceforge.net/
```

## apps/vpn/openvpn-2.0/Config.in
```kconfig
# vim:set syntax=kconfig:
config CONFIG_OPENVPN_2
  bool "openvpn2 - A full-featured SSL VPN solution (Generation TWO)"
  default n
  select CONFIG_LIBLZO
  select CONFIG_OPENSSL
  help
    OpenVPN is a full-featured SSL VPN solution which can 
    accomodate a wide range of configurations, including road 
    warrior access, home/office/campus telecommuting, WiFi 
    security, secure branch office linking, and enterprise-scale 
    remote access solutions with load balancing, failover, and 
    fine-grained access-controls.

    http://openvpn.net/
```

## apps/vpn/strongswan-2.x/Config.in
```kconfig
config CONFIG_STRONGSWAN
  bool "strongswan - an Open Source implementation of IPsec for Linux"
  default n
  select CONFIG_GMP
  help
    Strongswan is an Open Source implementation of IPsec for the Linux operating
    system. It is a code fork of the FreeS/WAN project, started by a few of the
    developers who were growing frustrated with the politics surrounding the
    FreeS/WAN project.

    http://www.openswan.org/
```

## apps/vpn/strongswan-4.x/Config.in
```kconfig
config CONFIG_STRONGSWAN
  bool "strongswan - an 'german' Open Source implementation of IPsec for Linux"
  default n
  select CONFIG_GMP
  help
    strongSwan is an OpenSource IPsec implementation for the Linux operating
    system. It is based on the discontinued FreeS/WAN project and the X.509
    patch which we developped over the last three years. In order to have a
    stable IPsec platform to base our future extensions of the X.509 capability
    on, we decided to lauch the strongSwan project.

    The focus is on
      
      * simplicity of configuration
      * strong encryption and authentication methods
      * powerful IPsec policies supporting large and complex VPN networks

    The maintainer of the strongSwan project is Andreas Steffen, who is a
    professor for security in communications at the University of Applied
    Sciences Rapperswil in Switzerland and president of the consulting firm
    strongSec GmbH.
    
    http://www.strongswan.org/
```
