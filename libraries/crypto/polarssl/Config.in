## libraries/crypto/polarssl/Config.in
```kconfig
# vim:set syntax=kconfig:
config CONFIG_POLARSSL
  bool "polarssl - a cryptographic library targeted at embedded systems"
  default n
  help
    The aim of the XySSL project is to provide a quality, open-source
    cryptographic library written in C and targeted at embedded systems;
    it can be used for free under the LGPL or BSD license.

    http://polarssl.org/
```

## libraries/database/dyndb/Config.in
```kconfig
config CONFIG_DYNDB
  bool "dyndb - a dynamical database"
  default n
  help
    A dyndb is database with 1 key <-> 1 value relation. The dyndb package
    contains fast and reliable tools to create, change and read that database.
    It also contains the library functions used by that programs.
    
    http://www.ohse.de/uwe/dyndb/
```

## libraries/database/qdbm/Config.in
```kconfig
config CONFIG_QDBM
  bool "QDBM: Quick Database Manager"
  default n
  help
    QDBM is a library of routines for managing a database. The database is a
    simple data file containing records, each is a pair of a key and a value.
    Every key and value is serial bytes with variable length. Both binary
    data and character string can be used as a key and a value.
    
    http://qdbm.sourceforge.net/
```

## libraries/database/sqlite2/Config.in
```kconfig
# vim:set syntax=kconfig:
config CONFIG_SQLITE_2
  bool "Sqlite2 - embeddable SQL database engine (Version 2.xx)"
  default n
  help
    SQLite is a C library that implements an SQL database engine. A large
    subset of SQL92 is supported. A complete database is stored in a
    single disk file. The API is designed for convenience and ease of use.
    Applications that link against SQLite can enjoy the power and
    flexiblity of an SQL database without the administrative hassles of
    supporting a separate database server.  Version 2 and version 3 binaries
    are named to permit each to be installed on a single host

    http://www.sqlite.org/
```

## libraries/database/sqlite3/Config.in
```kconfig
# vim:set syntax=kconfig:
config CONFIG_SQLITE_3
  bool "Sqlite3 - embeddable SQL database engine (Version 3.xx)"
  default n
  help
    SQLite is a C library that implements an SQL database engine. A large
    subset of SQL92 is supported. A complete database is stored in a
    single disk file. The API is designed for convenience and ease of use.
    Applications that link against SQLite can enjoy the power and
    flexiblity of an SQL database without the administrative hassles of
    supporting a separate database server.  Version 2 and version 3 binaries
    are named to permit each to be installed on a single host

    http://www.sqlite.org/
```

## libraries/dbus/Config.in
```kconfig
config CONFIG_DBUS
  bool "D-BUS message bus"
  default n
  help
    D-BUS is a system for sending messages between applications. It is
    used both for the systemwide message bus service, and as a
    per-user-login-session messaging facility.

    http://www.freedesktop.org/software/dbus/
```

## libraries/devel/pcl/Config.in
```kconfig
# vim:set syntax=kconfig:
config CONFIG_PCL
  bool "pcl - Portable Coroutine Library"
  default n
  help
    The Portable Coroutine Library (PCL) implements the low level functionality
    for coroutines. For a definition of the term coroutine see The Art of Computer
    Programming by Donald E. Knuth.

    http://www.xmailserver.org/libpcl.html
```

## libraries/expat/Config.in
```kconfig
config CONFIG_EXPAT
  bool "Expat - A library for parsing XML."
  default n
  help
    This is expat, the C library for parsing XML, written by James Clark. Expat
    is a stream oriented XML parser. This means that you register handlers with
    the parser prior to starting the parse. These handlers are called when the
    parser discovers the associated structures in the document being parsed. A
    start tag is an example of the kind of structures for which you may
    register handlers.

    http://www.libexpat.org/
```

## libraries/libcom_err/Config.in
```kconfig
# vim:set syntax=kconfig:
config CONFIG_LIBCOMERR
  bool "libcom_err - common error display library"
  default n
  help
    http://e2fsprogs.sourceforge.net/
```

## libraries/libevent2/Config.in
```kconfig
# vim:set syntax=kconfig:
config CONFIG_LIBEVENT
  bool "libevent - Abstract asynchronous event notification library"
  default n
  help
  The libevent API provides a mechanism to execute a callback function when
  a specific event occurs on a file descriptor or after a timeout has been
  reached. Furthermore, libevent also support callbacks due to signals or
  regular timeouts.

  libevent is meant to replace the event loop found in event driven network
  servers. An application just needs to call event_dispatch() and then add or
  remove events dynamically without having to change the event loop. 

    http://www.monkey.org/~provos/libevent/
```

## libraries/libjpeg/Config.in
```kconfig
# vim:set syntax=kconfig:
config CONFIG_LIBJPEG
  bool "libjpeg - A library for manipulating JPEG image format files"
  default n
  help
    The libjpeg package contains a library of functions for manipulating
    JPEG images, as well as simple client programs for accessing the
    libjpeg functions.  Libjpeg client programs include cjpeg, djpeg,
    jpegtran, rdjpgcom and wrjpgcom.  Cjpeg compresses an image file into
    JPEG format.  Djpeg decompresses a JPEG file into a regular image
    file.  Jpegtran can perform various useful transformations on JPEG
    files.  Rdjpgcom displays any text comments included in a JPEG file.
    Wrjpgcom inserts text comments into a JPEG file.

    http://www.ijg.org/
```

## libraries/libowfat/Config.in
```kconfig
config CONFIG_LIBOWFAT
  bool "libowfat - reimplement libdjb"
  default n
  help
    From the homepage of libowfat:
    
    One of the best ways to learn good programming practices is to read
    others people's code. I have read the source code from a lot of people.
    One of the most inspiring moments of my career as C programmer was to
    look at Dan Bernstein's code. While most programmers stumble about bad
    APIs throughout their life, Dan started not only question them, but he
    defined new and better APIs and implemented them.

    http://www.fefe.de/libowfat/
```

## libraries/libpcap/Config.in
```kconfig
# vim:set syntax=kconfig:
config CONFIG_LIBPCAP
  bool "libpcap - A system-independent interface for user-level packet capture"
  default n
  help
    Libpcap provides a portable framework for low-level network
    monitoring.  Libpcap can provide network statistics collection,
    security monitoring and network debugging.  Since almost every system
    vendor provides a different interface for packet capture, the libpcap
    authors created this system-independent API to ease in porting and to
    alleviate the need for several system-dependent packet capture modules
    in each application.

    Install libpcap if you need to do low-level network traffic monitoring
    on your network.

    http://www.tcpdump.org/
```

## libraries/libpng/Config.in
```kconfig
# vim:set syntax=kconfig:
config CONFIG_LIBPNG
  bool "libpng - A library of functions for manipulating PNG image format files"
  default n
  select CONFIG_ZLIB
  help
    The libpng package contains a library of functions for creating and
    manipulating PNG (Portable Network Graphics) image format files.  PNG
    is a bit-mapped graphics format similar to the GIF format.  PNG was
    created to replace the GIF format, since GIF uses a patented data
    compression algorithm.

    http://www.libpng.org/
```

## libraries/ncurses/Config.in
```kconfig
# vim:set syntax=kconfig:
config CONFIG_NCURSES
  bool "ncurses - A terminal handling library"
  default n
  help
    The curses library routines are a terminal-independent method of
    updating character screens with reasonable optimization. The ncurses
    (new curses) library is a freely distributable replacement for the
    discontinued 4.4 BSD classic curses library.

    http://www.gnu.org/software/ncurses/
    http://dickey.his.com/ncurses/
```

## libraries/netfilter/libnetfilter_conntrack/Config.in
```kconfig
# vim:set syntax=kconfig:
config CONFIG_LIBNETFILTER_CONNTRACK
  bool "libnetfilter_conntrack - access the in-kernel connection tracking state table."
  default n
  select CONFIG_PKGCONFIG
  help
    libnetfilter_conntrack is a userspace library providing a programming
    interface (API) to the in-kernel connection tracking state table.
    
    http://www.netfilter.org/projects/libnetfilter_conntrack/
```

## libraries/pcre/Config.in
```kconfig
config CONFIG_PCRE
  bool "pcre - Perl-compatible regular expression library"
  default n
  help
    PCRE has its own native API, but a set of "wrapper" functions that are based on
    the POSIX API are also supplied in the library libpcreposix. Note that this
    just provides a POSIX calling interface to PCRE: the regular expressions
    themselves still follow Perl syntax and semantics. The header file
    for the POSIX-style functions is called pcreposix.h.

    http://www.pcre.org
```

## libraries/tinyldap/Config.in
```kconfig
config CONFIG_TINYLDAP
  bool "tinyldap - a very small and very fast LDAP server"
  default n
  select CONFIG_LIBOWFAT
  help
    Tinyldap is an attempt to write a very small and very fast LDAP server.

    http://www.fefe.de/tinyldap/
```

## libraries/tre/Config.in
```kconfig
config CONFIG_TRE
  bool "tre - Lightweight, robust, and efficient POSIX compliant regexp matching library"
  default n
  help

    http://laurikari.net/tre/
```

## skeleton/Config.in
```kconfig
# vim:set syntax=kconfig:
config CONFIG_PACKAGE
  bool "package - A really nice package to do just everything"
  default n
  help
    A really nice Package description and everything about it

    http://www.package.org/
```
