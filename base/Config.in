## libraries/archiving/zlib/Config.in
```kconfig
# vim:set syntax=kconfig:
config CONFIG_ZLIB
  bool "zlib - The zlib compression and decompression library"
  default n
  help
    Zlib is a general-purpose, patent-free, lossless data compression
    library which is used by many different programs.

    http://www.gzip.org/zlib/
```

## libraries/crypto/axTLS/Config.in
```kconfig
# vim:set syntax=kconfig:
config CONFIG_AXTLS
  bool "axtls - highly configurable client/server TLSv1 SSL library"
  default n
  help
    The axTLS embedded SSL project is a highly configurable client/server 
    TLSv1 SSL library designed for platforms with small memory requirements.
    It comes with a small HTTP/HTTPS server and additional test tools.

    http://axtls.cerocclub.com.au/
```

## libraries/crypto/gnutls/Config.in
```kconfig
# vim:set syntax=kconfig:
config CONFIG_GNUTLS
  bool "GnuTLS"
  default n
  help
    http://www.gnu.org/software/gnutls/
```

## libraries/crypto/krb5/Config.in
```kconfig
# vim: set syntax=kconfig:
config CONFIG_KERBEROS5
  bool "Kerberos 5 - Kerberos network authentication system"
  default n
  select CONFIG_LIBCOMERR
  help
    Kerberos is a network authentication system. The krb5-libs package
    contains the shared libraries needed by Kerberos 5. If you are using
    Kerberos, you need to install this package.

    http://web.mit.edu/kerberos/www/
```

## libraries/crypto/libgcrypt/Config.in
```kconfig
# vim:set syntax=kconfig:
config CONFIG_LIBGCRYPT
  bool "libgcrypt - A general-purpose cryptography library"
  default n
  help
    Libgcrypt is a general purpose crypto library based on the code used
    in GNU Privacy Guard.

    http://www.gnupg.org/
  
  menu "Digests"
    depends CONFIG_LIBGCRYPT
    
    config CONFIG_LIBGCRYPT_DIGEST_CRC
    bool "crc - "
    depends CONFIG_LIBGCRYPT

    config CONFIG_LIBGCRYPT_DIGEST_MD4
    bool "md4 - message digest algorithm"
    depends CONFIG_LIBGCRYPT

    config CONFIG_LIBGCRYPT_DIGEST_SHA256
    bool "sha256 - The SHA (Secure Hash Algorithm) hash function"
    depends CONFIG_LIBGCRYPT

    config CONFIG_LIBGCRYPT_DIGEST_SHA512
    bool "sha512 - The SHA (Secure Hash Algorithm) hash function"
    depends CONFIG_LIBGCRYPT
  endmenu

  menu "Public key algos"
    depends CONFIG_LIBGCRYPT
    
    config CONFIG_LIBGCRYPT_PUBKEY_ELGAMAL
    bool "elgamal - asymmetric key encryption algorithm for public key cryptography"
    depends CONFIG_LIBGCRYPT

    config CONFIG_LIBGCRYPT_PUBKEY_RSA
    bool "rsa - algorithm for public-key encryption"
    depends CONFIG_LIBGCRYPT
  endmenu

  menu "Ciphers"
    depends CONFIG_LIBGCRYPT
    
    config CONFIG_LIBGCRYPT_CIPHERS_ARCFOUR
    bool "arcfour - The arcfour stream cipher"
    depends CONFIG_LIBGCRYPT

    config CONFIG_LIBGCRYPT_CIPHERS_BLOWFISH
    bool "blowfish - The blowfish keyed, symmetric block cipher"
    depends CONFIG_LIBGCRYPT

    config CONFIG_LIBGCRYPT_CIPHERS_CAST5
    bool "cast5 - Cast5 (CAST-128) block cipher"
    depends CONFIG_LIBGCRYPT

    config CONFIG_LIBGCRYPT_CIPHERS_AES
    bool "AES - Advanced Encryption Standard, also known as Rijndael"
    depends CONFIG_LIBGCRYPT

    config CONFIG_LIBGCRYPT_CIPHERS_TWOFISH
    bool "twofish - Twofish symmetric key block cipher"
    depends CONFIG_LIBGCRYPT

    config CONFIG_LIBGCRYPT_CIPHERS_SERPENT
    bool "serpent - Serpent symmetric key block cipher"
    depends CONFIG_LIBGCRYPT

    config CONFIG_LIBGCRYPT_CIPHERS_RFC2268
    bool "rfc2268 -RC2(r) Encryption Algorithm"
    depends CONFIG_LIBGCRYPT
  endmenu
```

## libraries/crypto/matrixssl/Config.in
```kconfig
config CONFIG_MATRIXSSL
  bool "MatrixSSL"
  default n
  help
    http://www.matrixssl.org/
```

## libraries/crypto/openssl-0.9.7/Config.in
```kconfig
# vim:set syntax=kconfig:
menu "OpenSSL"
config CONFIG_OPENSSL
  bool "OpenSSL"
  default n
  help
    The OpenSSL toolkit provides support for secure communications between
    machines. OpenSSL includes a certificate management tool and shared
    libraries which provide various cryptographic algorithms and
    protocols.

    http://www.openssl.org/

menu "Ciphers"
  config CONFIG_OPENSSL_AES
    bool "  AES"
    default y

  config CONFIG_OPENSSL_BF
    bool "  BF"
    default n

  config CONFIG_OPENSSL_CAST
    bool "  CAST"
    default n

  config CONFIG_OPENSSL_DES
    bool "  DES"
    default n

  config CONFIG_OPENSSL_DSA
    bool "  DSA"
    default y
  
  config CONFIG_OPENSSL_IDEA
    bool "  Idea"
    default n
  
  config CONFIG_OPENSSL_RSA
    bool "  RSA"
    default n
  
  config CONFIG_OPENSSL_RIPEMD
    bool "  RIPEMD"
    default n

  config CONFIG_OPENSSL_RC2
    bool "  RC2"
    default n

  config CONFIG_OPENSSL_RC5
    bool "  RC5"
    default n
endmenu

menu "Digests (Hash functions)"
  config CONFIG_OPENSSL_MD2
    bool "  Md2 digest algorithm"
    default n

  config CONFIG_OPENSSL_MD4
    bool "  Md4 digest algorithm"
    default n

  config CONFIG_OPENSSL_MD5
    bool "  Md5 digest algorithm"
    default y

  config CONFIG_OPENSSL_MDC2
    bool "  MDC2 digest algorithm"
    default n

  config CONFIG_OPENSSL_RMD160
    bool "  RMD160 digest algorithm"
    default n
  
  config CONFIG_OPENSSL_SHA
    bool "  SHA digest algorithm"
    default y
endmenu

config CONFIG_OPENSSL_ENGINE
  bool "  Engine"

config CONFIG_OPENSSL_ERR
  bool "  Err"

config CONFIG_OPENSSL_HW
  bool "  HW"

config CONFIG_OPENSSL_THREADS
  bool "  Build with Threads"

config CONFIG_OPENSSL_KRB5
  bool "  Kerberos 5 support"
  default n
  select CONFIG_KERBEROS5

config CONFIG_OPENSSL_OCSP
  bool "  OCSP support"

config CONFIG_OPENSSL_PKCS12
  bool "  PKCS12 support"

config CONFIG_OPENSSL_SSLV2
  bool "  SSLv2 support"

config CONFIG_OPENSSL_SSLV3
  bool "  SSLv3 support"

config CONFIG_OPENSSL_TLS1
  bool "  TLS1 support"
endmenu
```
