## base/Config.in
```kconfig
# vim:set syntax=kconfig:
menu "Basis"
source "base/coreutils/Config.in"
source "base/iproute/Config.in"
source "base/util-linux/Config.in"
source "base/minit/Config.in"
source "base/module-init-tools/Config.in"
source "base/vixie-cron/Config.in"
source "base/acl/Config.in"
source "base/attr/Config.in"
source "base/radvd/Config.in"
endmenu
```

## base/acl/Config.in
```kconfig
# vim:set syntax=kconfig:
config CONFIG_ACL
  bool "acl - Access control list utilities"
  default n
  select CONFIG_ATTR
  help
    This package contains the getfacl and setfacl utilities needed for
    manipulating access control lists.

    http://oss.sgi.com/projects/xfs/
```

## base/attr/Config.in
```kconfig
# vim:set syntax=kconfig:
config CONFIG_ATTR
  bool "attr - Utilities for managing filesystem extended attributes"
  default n
  help
    A set of tools for manipulating extended attributes on filesystem
    objects, in particular getfattr(1) and setfattr(1).
    An attr(1) command is also provided which is largely compatible
    with the SGI IRIX tool of the same name.

    http://oss.sgi.com/projects/xfs/
```

## base/coreutils/Config.in
```kconfig
# vim:set syntax=kconfig:
config CONFIG_COREUTILS
  bool "coreutils"
  default n
  select CONFIG_ATTR
  help
    These are the GNU core utilities. This package is the combination of
    the old GNU fileutils, sh-utils, and textutils packages.

    http://www.gnu.org/software/coreutils/
```

## base/iproute/Config.in
```kconfig
# vim:set syntax=kconfig:
config CONFIG_IPROUTE
  bool "iproute - Advanced IP routing and network device configuration tools"
  default y
  help
    The iproute package contains networking utilities (ip and rtmon, for
    example) which are designed to use the advanced networking
    capabilities of the Linux 2.4.x and 2.6.x kernel.

    http://linux-net.osdl.org/index.php/Iproute2
```

## base/minit/Config.in
```kconfig
# vim:set syntax=kconfig:
config CONFIG_MINIT
  bool "minit - a small yet feature-complete init"
  default n
  help
    http://www.fefe.de/minit/
```

## base/module-init-tools/Config.in
```kconfig
# vim:set syntax=kconfig:
config CONFIG_MODINIT
  bool "module-init-tools - Kernel module management utilities"
  default n
  help
    The modutils package includes various programs needed for automatic
    loading and unloading of modules under 2.6 and later kernels, as well
    as other module management programs. Device drivers and filesystems
    are two examples of loaded and unloaded modules.

    http://www.kernel.org/pub/linux/utils/kernel/module-init-tools/
```

## base/radvd/Config.in
```kconfig
# vim:set syntax=kconfig:
config CONFIG_RADVD
  bool "radvd - Linux IPv6 Router Advertisement Daemon"
  default n
  help
    The router advertisement daemon (radvd) is run by Linux or BSD systems
    acting as IPv6 routers. It sends Router Advertisement messages, specified
    by RFC 2461, to a local Ethernet LAN periodically and when requested by a
    node sending a Router Solicitation message. These messages are required
    for IPv6 stateless autoconfiguration.

    http://www.litech.org/radvd/
```

## base/util-linux/Config.in
```kconfig
# vim:set syntax=kconfig:
config CONFIG_UTIL_LINUX
  bool "util-linux - A collection of basic system utilities"
  default n
  help
    The util-linux package contains a large variety of low-level system
    utilities that are necessary for a Linux system to function. Among
    others, Util-linux contains the fdisk configuration tool and the login
    program.

  config CONFIG_UTIL_LINUX_LOGIN
  bool "login - sign on"
  depends CONFIG_UTIL_LINUX
  
  config CONFIG_UTIL_LINUX_KILL
  bool "kill - terminate a process"
  depends CONFIG_UTIL_LINUX
  
  config CONFIG_UTIL_LINUX_MOUNT
  bool "mount - mount a file system"
  depends CONFIG_UTIL_LINUX
  
  config CONFIG_UTIL_LINUX_UMOUNT
  bool "umount - unmount file systems"
  depends CONFIG_UTIL_LINUX
  
  config CONFIG_UTIL_LINUX_ARCH
  bool "arch - print machine architecture"
  depends CONFIG_UTIL_LINUX
  
  config CONFIG_UTIL_LINUX_DMESG
  bool "dmesg - print or control the kernel ring buffer"
  depends CONFIG_UTIL_LINUX
  
  config CONFIG_UTIL_LINUX_MKFS
  bool "mkfs - build a Linux file system"
  depends CONFIG_UTIL_LINUX
  
  config CONFIG_UTIL_LINUX_MKSWAP
  bool "mkswap - set up a Linux swap area"
  depends CONFIG_UTIL_LINUX
  
  config CONFIG_UTIL_LINUX_BLOCKDEV
  bool "blockdev - call block device ioctls from the command line"
  depends CONFIG_UTIL_LINUX
  
  config CONFIG_UTIL_LINUX_ELVTUNE
  bool "elvtune - I/O elevator tuner"
  depends CONFIG_UTIL_LINUX
  
  config CONFIG_UTIL_LINUX_FSCK_MINIX
  bool "fsck.minix - check a minix file system"
  depends CONFIG_UTIL_LINUX
  
  config CONFIG_UTIL_LINUX_FSCK_CRAMFS
  bool "cramfsck - check a cramfs file system"
  depends CONFIG_UTIL_LINUX
  
  config CONFIG_UTIL_LINUX_MKFS_MINIX
  bool "mkfs.minix - make a Linux MINIX filesystem"
  depends CONFIG_UTIL_LINUX
  
  config CONFIG_UTIL_LINUX_MKFS_BFS
  bool "mkfs.bfs - make an SCO bfs filesystem"
  depends CONFIG_UTIL_LINUX
  
  config CONFIG_UTIL_LINUX_MKFS_CRAMFS
  bool "mkcramfs - make a cramfs file system"
  depends CONFIG_UTIL_LINUX
  
  config CONFIG_UTIL_LINUX_AGETTY
  bool "agetty - alternative Linux getty"
  depends CONFIG_UTIL_LINUX
  
  config CONFIG_UTIL_LINUX_SWAPON
  bool "swapon - enable devices and files for paging and swapping"
  depends CONFIG_UTIL_LINUX
  
  config CONFIG_UTIL_LINUX_LOSETUP
  bool "losetup - set up and control loop devices"
  depends CONFIG_UTIL_LINUX
  
  config CONFIG_UTIL_LINUX_SWAPOFF
  bool "swapoff - disable devices and files for paging and swapping"
  depends CONFIG_UTIL_LINUX
  
  config CONFIG_UTIL_LINUX_FDISK
  bool "fdisk - Partition table manipulator for Linux"
  depends CONFIG_UTIL_LINUX
  
  config CONFIG_UTIL_LINUX_SFDISK
  bool "sfdisk - Partition table manipulator for Linux"
  depends CONFIG_UTIL_LINUX
  
  config CONFIG_UTIL_LINUX_HWCLOCK
  bool "hwclock - query and set the hardware clock (RTC)"
  depends CONFIG_UTIL_LINUX
  
  config CONFIG_UTIL_LINUX_CTRLALTDEL
  bool "ctrlaltdel - set the function of the Ctrl-Alt-Del combination"
  depends CONFIG_UTIL_LINUX
  
  config CONFIG_UTIL_LINUX_SLN
  bool "sln - static ln"
  depends CONFIG_UTIL_LINUX
  
  config CONFIG_UTIL_LINUX_GETOPT
  bool "getopt - parse command options"
  depends CONFIG_UTIL_LINUX
  
  config CONFIG_UTIL_LINUX_FDFORMAT
  bool "fdformat - Low-level formats a floppy disk"
  depends CONFIG_UTIL_LINUX
  
  config CONFIG_UTIL_LINUX_ISOSIZE
  bool "isosize - outputs the length of a iso9660 file system"
  depends CONFIG_UTIL_LINUX
  
  config CONFIG_UTIL_LINUX_SETFDPRM
  bool "setfdprm - sets user-provided floppy disk parameters"
  depends CONFIG_UTIL_LINUX
  
  config CONFIG_UTIL_LINUX_RAW
  bool "raw - bind a Linux raw character device"
  depends CONFIG_UTIL_LINUX
  
  config CONFIG_UTIL_LINUX_CAL
  bool "cal - displays a calendar"
  depends CONFIG_UTIL_LINUX
  
  config CONFIG_UTIL_LINUX_CHKDUPEXE
  bool "chkdupexe - find duplicate executables"
  depends CONFIG_UTIL_LINUX
  
  config CONFIG_UTIL_LINUX_DDATE
  bool "ddate - converts Gregorian dates to Discordian dates"
  depends CONFIG_UTIL_LINUX
  
  config CONFIG_UTIL_LINUX_LOGGER
  bool "logger - a shell command interface to the syslog(3) system log module"
  depends CONFIG_UTIL_LINUX
  
  config CONFIG_UTIL_LINUX_LOOK
  bool "look - display lines beginning with a given string"
  depends CONFIG_UTIL_LINUX
  
  config CONFIG_UTIL_LINUX_MCOOKIE
  bool "mcookie - generate magic cookies for xauth"
  depends CONFIG_UTIL_LINUX
  
  config CONFIG_UTIL_LINUX_NAMEI
  bool "namei - follow a pathname until a terminal point is found"
  depends CONFIG_UTIL_LINUX
  
  config CONFIG_UTIL_LINUX_RENAME
  bool "rename - Rename files"
  depends CONFIG_UTIL_LINUX
  
  config CONFIG_UTIL_LINUX_SCRIPT
  bool "script - make typescript of terminal session"
  depends CONFIG_UTIL_LINUX
  
  config CONFIG_UTIL_LINUX_WHEREIS
  bool "whereis - locate the binary, source, and manual page files for a command"
  depends CONFIG_UTIL_LINUX
  
  config CONFIG_UTIL_LINUX_WRITE
  bool "write - send a message to another user"
  depends CONFIG_UTIL_LINUX
  
  config CONFIG_UTIL_LINUX_IPCRM
  bool "ipcrm - remove an XSI message queue, semaphore set, or shared memory segment identifier"
  depends CONFIG_UTIL_LINUX
  
  config CONFIG_UTIL_LINUX_IPCS
  bool "ipcs - report XSI interprocess communication facilities status"
  depends CONFIG_UTIL_LINUX
  
  config CONFIG_UTIL_LINUX_RENICE
  bool "renice - set nice values of running processes"
  depends CONFIG_UTIL_LINUX
  
  config CONFIG_UTIL_LINUX_SETSID
  bool "setsid - run a program in a new session"
  depends CONFIG_UTIL_LINUX
  
  config CONFIG_UTIL_LINUX_COL
  bool "col - filter reverse line feeds from input"
  depends CONFIG_UTIL_LINUX
  
  config CONFIG_UTIL_LINUX_COLCRT
  bool "colcrt - filter nroff output for CRT previewing"
  depends CONFIG_UTIL_LINUX
  
  config CONFIG_UTIL_LINUX_COLRM
  bool "colrm - remove columns from a file"
  depends CONFIG_UTIL_LINUX
  
  config CONFIG_UTIL_LINUX_COLUMN
  bool "column - columnate lists"
  depends CONFIG_UTIL_LINUX
  
  config CONFIG_UTIL_LINUX_HEXDUMP
  bool "hexdump - ascii, decimal, hexadecimal, octal dump"
  depends CONFIG_UTIL_LINUX
  
  config CONFIG_UTIL_LINUX_REV
  bool "rev - reverse lines of a file"
  depends CONFIG_UTIL_LINUX

  config CONFIG_UTIL_LINUX_LINE
  bool "line - read one line"
  depends CONFIG_UTIL_LINUX
```

## base/vixie-cron/Config.in
```kconfig
# vim:set syntax=kconfig:
config CONFIG_CRON
  bool "vixie cron - A daemon for executing specified programs at set times"
  default n
  help
    The vixie-cron package contains the Vixie version of cron.  Cron is a
    standard UNIX daemon that runs specified programs at scheduled times.
    Vixie cron adds better security and more powerful configuration
    options to the standard version of cron.

    
```

## development/Config.in
```kconfig
# vim:set syntax=kconfig:
menu "Toolchain"
#  source "dietlibc/Config.in"
  source "development/gcc/Config.in"
  source "development/gcc4.1/Config.in"
  source "development/automake/Config.in"
  source "development/binutils/Config.in"
  source "development/bison/Config.in"
  source "development/flex/Config.in"
  source "development/libtool/Config.in"
#  source "development/makedepend/Config.in"
endmenu
```

## development/automake/Config.in
```kconfig
# vim:set syntax=kconfig:
config CONFIG_AUTOMAKE
  bool "automake - A GNU tool for automatically creating Makefiles"
  default y
  help
    Automake is a tool for automatically generating `Makefile.in'
    files compliant with the GNU Coding Standards.

    You should install Automake if you are developing software and would
    like to use its ability to automatically generate GNU standard
    Makefiles. If you install Automake, you will also need to install
    GNU's Autoconf package.

    http://sources.redhat.com/automake
```

## development/binutils/Config.in
```kconfig
config CONFIG_BINUTILS
	bool "binutils - Tools necessary to build programs"
	default y
	help
	  GNU binutils work mostly behind the scenes of Linux development, largely
	  because GNU make and the GCC frontend does so many things automatically.
	  Utilities include: ld as nm objdump objcopy nm ar ranlib strip c filt size
	  addr2line and dlltool.

	  http://sources.redhat.com/binutils/
```

## development/flex/Config.in
```kconfig
# vim:set syntax=kconfig:
config CONFIG_FLEX
  bool "Flex - A tool for creating scanners (text pattern recognizers)"
  default y
  help
    The flex program generates scanners.  Scanners are programs which can
    recognize lexical patterns in text.  Flex takes pairs of regular
    expressions and C code as input and generates a C source file as
    output.  The output file is compiled and linked with a library to
    produce an executable.  The executable searches through its input for
    occurrences of the regular expressions.  When a match is found, it
    executes the corresponding C code.  Flex was designed to work with
    both Yacc and Bison, and is used by many programs as part of their
    build process.

    You should install flex if you are going to use your system for
    application development.
    
    http://flex.sourceforge.net/
```

## development/gcc4.1/Config.in
```kconfig
# vim:set syntax=kconfig:
config CONFIG_GCC
  bool "GCC - The GNU Compiler Collection. Includes C/C++ compilers (4.1.x)"
  default y
  help
    The GNU Compiler Collection contains frontends for C, C++, Objective-C,
    Fortran, Java, and Ada as well as libraries for these languages. It is
    a full-featured ANSI C compiler with support for K&R C as well. GCC
    provides many levels of source code error checking traditionally provided
    by other tools (such as lint), produces debugging information, and can
    perform many different optimizations to the resulting object code.

    http://gcc.gnu.org/

config CONFIG_GCC_CPLUSPLUS
    bool "- C++ Support"
    depends on CONFIG_GCC
    default y

config CONFIG_GCC_PASCAL
    bool "- Pascal Support"
    depends on CONFIG_GCC
    default n
```

## development/libtool/Config.in
```kconfig
# vim:set syntax=kconfig:
config CONFIG_LIBTOOL
  bool "libtool - The GNU Portable Library Tool"
  default y
  help
    GNU Libtool is a set of shell scripts which automatically configure UNIX and
    UNIX-like systems to generically build shared libraries. Libtool provides a
    consistent, portable interface which simplifies the process of using shared
    libraries.

    If you are developing programs which will use shared libraries, but do not use
    the rest of the GNU Autotools (such as GNU Autoconf and GNU Automake), you
    should install the libtool package.

    The libtool package also includes all files needed to integrate the GNU
    Portable Library Tool (libtool) and the GNU Libtool Dynamic Module Loader
    (ltdl) into a package built using the GNU Autotools (including GNU Autoconf
    and GNU Automake).

    http://www.gnu.org/software/libtool/
```

## libraries/Config.in
```kconfig
# vim:set syntax=kconfig:

menu "Libraries"
menu "Database"
source "libraries/database/db-4.1/Config.in"
source "libraries/database/qdbm/Config.in"
source "libraries/database/sqlite2/Config.in"
source "libraries/database/sqlite3/Config.in"
endmenu

menu "Cryptography"
source "libraries/crypto/matrixssl/Config.in"
source "libraries/crypto/libgcrypt/Config.in"
source "libraries/crypto/gnutls/Config.in"
source "libraries/crypto/openssl/Config.in"
source "libraries/crypto/krb5/Config.in"
source "libraries/crypto/axTLS/Config.in"
source "libraries/crypto/polarssl/Config.in"
endmenu

menu "Archiving"
source "libraries/archiving/liblzo/Config.in"
source "libraries/archiving/zlib/Config.in"
source "libraries/archiving/libtar/Config.in"
endmenu

menu "Firewalling"
source "libraries/netfilter/libnfnetlink/Config.in"
source "libraries/netfilter/libnetfilter_conntrack/Config.in"
endmenu

menu "Graphics"
source "libraries/libpng/Config.in"
source "libraries/libjpeg/Config.in"
endmenu

menu "Generic"
source "libraries/dbus/Config.in"
source "libraries/expat/Config.in"
source "libraries/gmp/Config.in"
source "libraries/libpcap/Config.in"
source "libraries/ncurses/Config.in"
source "libraries/libevent/Config.in"
source "libraries/libowfat/Config.in"
source "libraries/mm/Config.in"
source "libraries/pcre/Config.in"
source "libraries/tre/Config.in"
source "libraries/openldap/Config.in"
source "libraries/libcom_err/Config.in"
endmenu

menu "Development"
source "libraries/devel/pcl/Config.in"
endmenu
endmenu
```

## libraries/archiving/libtar/Config.in
```kconfig
# vim:set syntax=kconfig:
config CONFIG_LIBTAR
  bool "libtar - a C library for manipulating tar archives"
  default n
  help
    libtar is a C library for manipulating tar archives. It supports both
    the strict POSIX tar format and many of the commonly-used GNU extensions.

    http://www.feep.net/libtar/
```
